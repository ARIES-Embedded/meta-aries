## conf/layer.conf
```bitbake
# We have a conf and classes directory, add to BBPATH
BBPATH .= ":${LAYERDIR}"

# We have a packages directory, add to BBFILES
BBFILES += "${LAYERDIR}/recipes-*/*/*.bb"
BBFILES += "${LAYERDIR}/recipes-*/*/*.bbappend"

BBFILE_COLLECTIONS += "aries"
BBFILE_PATTERN_aries = "^${LAYERDIR}/"
BBFILE_PRIORITY_aries = "5"

LAYERDEPENDS_aries = "core"
LAYERSERIES_COMPAT_aries = "dunfell"
```

## conf/machine/m28evk.conf
```bitbake
#@TYPE: Machine
#@NAME: DENX M28 SoM Evaluation Kit
#@SOC:  Freescale i.MX28
#@DESCRIPTION: Machine configuration for DENX M28 SoM Evaluation Kit

DEFAULTTUNE ?= "armv5te"
SOC_FAMILY ?= "mxs"

require conf/machine/include/tune-arm926ejs.inc
require conf/machine/include/soc-family.inc

MACHINE_FEATURES ?= "apm alsa ext2 keyboard screen serial touchscreen usbgadget usbhost"

SERIAL_CONSOLE = "115200 ttyAMA0"

EXTRA_IMAGEDEPENDS += "u-boot"

# U-Boot bootloader
UBOOT_ENTRYPOINT := "0x40008000"
UBOOT_MAKE_TARGET := "u-boot.sb"
UBOOT_BINARY := "u-boot.sb"
UBOOT_SUFFIX ?= "sb"
UBOOT_MACHINE = "m28evk_defconfig"

PREFERRED_VERSION_u-boot ?= "2018.11%"
PREFERRED_VERSION_u-boot-mkimage ?= "2018.11%"

# Linux kernel
KERNEL_IMAGETYPE = "fitImage"
KERNEL_CLASSES += " kernel-fitimage "
KERNEL_DEVICETREE = "imx28-m28evk.dtb"

PREFERRED_PROVIDER_virtual/kernel = "linux-yocto"
PREFERRED_VERSION_linux-yocto = "4.14%"

# Ship kernel modules
MACHINE_ESSENTIAL_EXTRA_RDEPENDS = "kernel-modules kernel-devicetree"

# List of images to be built
IMAGE_FSTYPES ?= "tar.xz ext4 wic.xz"
INITRAMFS_FSTYPES ?= "cpio.xz"

WKS_FILE = "sdimage-m28evk.wks"
IMAGE_BOOT_FILES ?= "${KERNEL_IMAGETYPE} u-boot.sb u-boot.nand"
IMAGE_INSTALL_append = " kernel-devicetree kernel-image-fitimage"
do_image_wic[depends] += "mtools-native:do_populate_sysroot dosfstools-native:do_populate_sysroot"
```

## conf/machine/m53evk.conf
```bitbake
#@TYPE: Machine
#@NAME: DENX M53 SoM Evaluation Kit
#@SOC:  Freescale i.MX53
#@DESCRIPTION: Machine configuration for DENX M53 SoM Evaluation Kit

DEFAULTTUNE ?= "cortexa8thf-neon"
SOC_FAMILY ?= "imx53"

require conf/machine/include/tune-cortexa8.inc
require conf/machine/include/soc-family.inc

MACHINE_FEATURES ?= "apm alsa ext2 keyboard screen serial touchscreen usbgadget usbhost"

SERIAL_CONSOLE = "115200 ttymxc1"

EXTRA_IMAGEDEPENDS += "u-boot"

# U-Boot bootloader
UBOOT_ENTRYPOINT := "0x70008000"
UBOOT_MAKE_TARGET := "u-boot.imx"
UBOOT_BINARY := "u-boot.imx"
UBOOT_SUFFIX ?= "imx"
UBOOT_MACHINE = "m53evk_defconfig"

PREFERRED_VERSION_u-boot ?= "2018.11%"
PREFERRED_VERSION_u-boot-mkimage ?= "2018.11%"
PREFERRED_VERSION_u-boot-fw-utils ?= "2018.11%"
PREFERRED_RPROVIDER_u-boot-fw-utils ?= "u-boot-fw-utils"

# Linux kernel
KERNEL_IMAGETYPE = "fitImage"
KERNEL_CLASSES += " kernel-fitimage "
KERNEL_DEVICETREE = "imx53-m53evk.dtb"

PREFERRED_PROVIDER_virtual/kernel = "linux-yocto"
PREFERRED_VERSION_linux-yocto = "5.4%"

# Ship kernel modules
MACHINE_ESSENTIAL_EXTRA_RDEPENDS = "kernel-modules kernel-devicetree sdma-firmware"

# List of images to be built
IMAGE_FSTYPES ?= "tar.xz ext4 wic.xz"
INITRAMFS_FSTYPES ?= "cpio.xz"

WKS_FILE = "sdimage-m53evk.wks"
IMAGE_BOOT_FILES ?= "${KERNEL_IMAGETYPE} u-boot-with-nand-spl.imx"
IMAGE_INSTALL_append = " kernel-devicetree kernel-image-fitimage"
do_image_wic[depends] += "mtools-native:do_populate_sysroot dosfstools-native:do_populate_sysroot"
```

## conf/machine/ma5d4evk.conf
```bitbake
#@TYPE: Machine
#@NAME: DENX MA5D4 SoM Evaluation Kit
#@SOC:  Atmel SAMA5D4
#@DESCRIPTION: Machine configuration for DENX MA5D4 SoM Evaluation Kit

DEFAULTTUNE ?= "cortexa5thf-neon"
SOC_FAMILY ?= "sama5"

require conf/machine/include/arm/armv7a/tune-cortexa5.inc
require conf/machine/include/soc-family.inc

MACHINE_FEATURES ?= "apm ext2 keyboard screen serial touchscreen usbgadget usbhost"

SERIAL_CONSOLE = "115200 ttyS3"

EXTRA_IMAGEDEPENDS += "u-boot"

# U-Boot bootloader
UBOOT_ENTRYPOINT := "0x20008000"
UBOOT_MAKE_TARGET := "u-boot.img"
UBOOT_BINARY := "u-boot.img"
UBOOT_SUFFIX ?= "img"
UBOOT_MACHINE = "ma5d4evk_defconfig"

PREFERRED_VERSION_u-boot ?= "2018.11%"
PREFERRED_VERSION_u-boot-mkimage ?= "2018.11%"
PREFERRED_VERSION_u-boot-fw-utils ?= "2018.11%"
PREFERRED_RPROVIDER_u-boot-fw-utils ?= "u-boot-fw-utils"

# Linux kernel
KERNEL_IMAGETYPE = "fitImage"
KERNEL_CLASSES += " kernel-fitimage "
KERNEL_DEVICETREE = "at91-sama5d4_ma5d4sfevk.dtb at91-sama5d4_ma5d4emmcevk.dtb"

PREFERRED_PROVIDER_virtual/kernel = "linux-yocto"
PREFERRED_VERSION_linux-yocto = "5.4%"
#PREFERRED_VERSION_linux-yocto = "4.14%"

# Ship kernel modules
MACHINE_ESSENTIAL_EXTRA_RDEPENDS = "kernel-modules kernel-devicetree"

# List of images to be built
IMAGE_FSTYPES ?= "tar.xz ext4 wic.xz"
INITRAMFS_FSTYPES ?= "cpio.xz"

WKS_FILE = "sdimage-ma5d4evk.wks"
IMAGE_BOOT_FILES ?= "${KERNEL_IMAGETYPE} boot.bin u-boot.img"
IMAGE_INSTALL:append = " kernel-devicetree kernel-image-fitimage"
do_image_wic[depends] += "mtools-native:do_populate_sysroot dosfstools-native:do_populate_sysroot"
```

## conf/machine/maxevk.conf
```bitbake
#@TYPE: Machine
#@NAME: Aries Embedded MAX SoM Evaluation Kit
#@SOC:  Altera Arria 10 SoC
#@DESCRIPTION: Machine configuration for Aries Embedded MAX SoM Evaluation Kit

DEFAULTTUNE ?= "cortexa9thf-neon"
SOC_FAMILY ?= "socfpga"

require conf/machine/include/arm/armv7a/tune-cortexa9.inc
require conf/machine/include/soc-family.inc

MACHINE_FEATURES ?= "apm ext2 keyboard screen serial touchscreen usbgadget usbhost pci"

SERIAL_CONSOLE = "115200 ttyS0"

EXTRA_IMAGEDEPENDS += "u-boot"

# U-Boot bootloader
UBOOT_ENTRYPOINT := "0x00008000"
UBOOT_MAKE_TARGET := "u-boot-with-spl.sfp"
SPL_BINARY := "spl/u-boot-splx4.sfp"
UBOOT_BINARY = "u-boot.img"
UBOOT_SUFFIX ?= "sfp"
UBOOT_MACHINE = "socfpga_maxevk_defconfig"

PREFERRED_RPROVIDER_u-boot-fw-utils ?= "libubootenv"
PREFERRED_VERSION_u-boot ?= "2021.01%"

# Linux kernel
KERNEL_IMAGETYPE = "fitImage"
KERNEL_CLASSES += " kernel-fitimage "
KERNEL_DEVICETREE = "socfpga_arria10_maxevk.dtb"

UBOOT_EXTLINUX ?= "1"
UBOOT_EXTLINUX_LABELS ?= "default"
UBOOT_EXTLINUX_DEFAULT_LABEL ?= "Aries MAX EVK"

UBOOT_EXTLINUX_MENU_DESCRIPTION_default ?= "Aries MAX EVK"
UBOOT_EXTLINUX_KERNEL_IMAGE_default ?= "../${KERNEL_IMAGETYPE}"
UBOOT_EXTLINUX_FDT_default = ""
UBOOT_EXTLINUX_FDTDIR_default = ""
UBOOT_EXTLINUX_KERNEL_ARGS_default ?= "rootwait rw earlycon"
UBOOT_EXTLINUX_ROOT ?= "root=/dev/mmcblk0p3"
UBOOT_EXTLINUX_CONSOLE ?= "console=ttyS0,${baudrate}"

#PREFERRED_PROVIDER_virtual/kernel ?= "linux-altera-lts"
#PREFERRED_VERSION_linux-altera-lts ?= "5.10%"
PREFERRED_PROVIDER_virtual/kernel ?= "linux-altera-lts"
PREFERRED_VERSION_linux-altera-lts ?= "5.15%"

# Ship kernel modules
MACHINE_ESSENTIAL_EXTRA_RDEPENDS = "kernel-modules kernel-devicetree"

# List of images to be built
IMAGE_FSTYPES ?= "tar.xz ext4 wic.xz"
INITRAMFS_FSTYPES ?= "cpio.xz"

WKS_FILE = "sdimage-maxevk.wks"
IMAGE_BOOT_FILES ?= " \
	${KERNEL_IMAGETYPE} \
	${UBOOT_BINARY} \
	extlinux.conf;extlinux/extlinux.conf \
	fit_spl_fpga.itb \
	"

IMAGE_INSTALL:append = " kernel-devicetree kernel-image-fitimage"
do_image_wic[depends] += "mtools-native:do_populate_sysroot dosfstools-native:do_populate_sysroot u-boot:do_deploy"
```

## conf/machine/mcvevk.conf
```bitbake
#@TYPE: Machine
#@NAME: DENX MCV SoM Evaluation Kit
#@SOC:  Altera Cyclone V SoC
#@DESCRIPTION: Machine configuration for DENX MCV SoM Evaluation Kit

DEFAULTTUNE ?= "cortexa9thf-neon"
SOC_FAMILY ?= "socfpga"

require conf/machine/include/arm/armv7a/tune-cortexa9.inc
require conf/machine/include/soc-family.inc

MACHINE_FEATURES ?= "apm ext2 keyboard screen serial touchscreen usbgadget usbhost pci"

SERIAL_CONSOLE = "115200 ttyS0"

EXTRA_IMAGEDEPENDS += "u-boot"

# U-Boot bootloader
UBOOT_ENTRYPOINT := "0x00008000"
UBOOT_MAKE_TARGET := "u-boot-with-spl.sfp"
UBOOT_BINARY := "u-boot-with-spl.sfp"
UBOOT_SUFFIX ?= "sfp"
UBOOT_MACHINE = "socfpga_mcvevk_defconfig"

PREFERRED_VERSION_u-boot ?= "2022.01%"
PREFERRED_VERSION_u-boot-tools ?= "2022.01%"
PREFERRED_PROVIDER_u-boot-fw-utils ?= "libubootenv"

# Linux kernel
KERNEL_IMAGETYPE = "fitImage"
KERNEL_CLASSES += " kernel-fitimage "
KERNEL_DEVICETREE = "socfpga_cyclone5_mcvevk.dtb socfpga_cyclone5_mcvevp_rev2_fb.dtb"

#PREFERRED_PROVIDER_virtual/kernel ?= "linux-altera-lts"
#PREFERRED_VERSION_linux-altera-lts ?= "5.10%"
PREFERRED_PROVIDER_virtual/kernel ?= "linux-altera-lts"
PREFERRED_VERSION_linux-altera-lts ?= "5.15%"

# Ship kernel modules
MACHINE_ESSENTIAL_EXTRA_RDEPENDS = "kernel-modules kernel-devicetree"

# List of images to be built
IMAGE_FSTYPES ?= "tar.xz ext4 wic.xz"
INITRAMFS_FSTYPES ?= "cpio.xz"

WKS_FILE = "sdimage-mcvevk.wks"
IMAGE_BOOT_FILES ?= "${KERNEL_IMAGETYPE}"
IMAGE_INSTALL:append = " kernel-devicetree kernel-image-fitimage"
do_image_wic[depends] += "mtools-native:do_populate_sysroot dosfstools-native:do_populate_sysroot"
```

## scripts/lib/wic/canned-wks/sdimage-m53evk.wks
```
# short-description: Create M53EVK SD card image with a boot partition
# long-description: Creates a partitioned SD card image. Boot files
# are located in the first ext4 partition.

part --source rawcopy --sourceparams="file=u-boot.imx" --ondisk mmcblk --no-table --align 1 --size 2M
part /boot --source bootimg-partition --ondisk mmcblk --fstype=ext4 --label boot --active --align 4096 --size 16M --extra-space 0 --overhead-factor 1
part / --source rootfs --ondisk mmcblk --fstype=ext4 --label root --align 4096
```

## scripts/lib/wic/canned-wks/sdimage-ma5d4evk-comm.wks
```
# short-description: Create MA5D4EVK commissioning SD card image with a boot partition
# long-description: Creates a partitioned SD card image. Boot files
# are located in the first ext4 partition.

# AT91 needs VFAT boot partition
part /boot --source bootimg-partition --ondisk mmcblk --fstype=vfat --label boot --active --align 4096 --size 8M --extra-space 0 --overhead-factor 1
```

## scripts/lib/wic/canned-wks/sdimage-ma5d4evk.wks
```
# short-description: Create MA5D4EVK SD card image with a boot partition
# long-description: Creates a partitioned SD card image. Boot files
# are located in the first ext4 partition.

# AT91 needs VFAT boot partition
part /boot --source bootimg-partition --ondisk mmcblk --fstype=vfat --label boot --active --align 4096 --size 16M --extra-space 0 --overhead-factor 1
part / --source rootfs --ondisk mmcblk --fstype=ext4 --label root --align 4096
```

## scripts/lib/wic/canned-wks/sdimage-maxevk.wks
```
# short-description: Create MAXEVK SD card image with a boot partition
# long-description: Creates a partitioned SD card image. Boot files
# are located in the first ext4 partition.

part /boot --source bootimg-partition --ondisk mmcblk0 --fstype=vfat --label boot --active --align 4096 --size 50M --extra-space 0 --overhead-factor 1
part --source rawcopy --sourceparams="file=u-boot-splx4.sfp" --ondisk mmcblk0 --system-id 0xa2 --align 1024 --size 2M
part / --source rootfs --ondisk mmcblk0 --fstype=ext4 --label root --align 4096
```
